## meta-gamercial/conf/layer.conf
```bitbake
# We have a conf and classes directory, add to BBPATH
BBPATH .= ":${LAYERDIR}"

# We have recipes-* directories, add to BBFILES
BBFILES += "${LAYERDIR}/recipes-*/*/*.bb \
            ${LAYERDIR}/recipes-*/*/*.bbappend"

BBFILE_COLLECTIONS += "meta-gamercial"
BBFILE_PATTERN_meta-gamercial = "^${LAYERDIR}/"
BBFILE_PRIORITY_meta-gamercial = "6"

LAYERDEPENDS_meta-gamercial = "core"
LAYERSERIES_COMPAT_meta-gamercial = "gatesgarth"
```

## meta-train/conf/layer.conf
```bitbake
# We have a conf and classes directory, add to BBPATH
BBPATH .= ":${LAYERDIR}"

# We have recipes-* directories, add to BBFILES
BBFILES += "${LAYERDIR}/recipes-*/*/*.bb \
            ${LAYERDIR}/recipes-*/*/*.bbappend"

BBFILE_COLLECTIONS += "meta-train"
BBFILE_PATTERN_meta-train = "^${LAYERDIR}/"
BBFILE_PRIORITY_meta-train = "6"

LAYERDEPENDS_meta-train = "core"
LAYERSERIES_COMPAT_meta-train = "gatesgarth"
```
